	fbtft@0{
		status = "okay";
		compatible = "sitronix,st7735r";
		reg = <0>;
		spi-max-frequency = <48000000>;
		
		// spi模式
		// spi-cpol;
		// spi-cpha;

		fps = <30>;
		buswidth = <8>;
		debug = <0x7>;
		width = <128>;
		height = <128>;
		
		bgr;                // 这个解决了对角一个像素点 乱码的问题
		//rgb;
		//rotate = <90>;

		backlight = <&backlight>;
		// led-gpios = <&gpio2 RK_PB0 GPIO_ACTIVE_HIGH>;	  //BL
		dc-gpios = <&gpio2 RK_PB1 GPIO_ACTIVE_HIGH>;      //DC
		reset-gpios = <&gpio1 RK_PC3 GPIO_ACTIVE_LOW>;    //RES
	};